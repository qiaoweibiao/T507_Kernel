## drivers/misc/ite6807/Kconfig
```kconfig
config ITE6807_HDMI_VBYONE
tristate "external hdmi switch vbyone chip driver 4k panel"
default N
help
This is hdmi switch vbyone driver
```

## drivers/net/wireless/uwe5622/Kconfig
```kconfig
config SPARD_WLAN_SUPPORT
	bool "Spreadtrum wireless Support"
	select SC23XX  if SPARD_WLAN_SUPPORT
	select UMW2652 if SPARD_WLAN_SUPPORT
	select SDIOHAL if SPARD_WLAN_SUPPORT
	select WCN_SLP if SPARD_WLAN_SUPPORT
	select WCN_BOOT  if SPARD_WLAN_SUPPORT
	select WCN_UTILS if SPARD_WLAN_SUPPORT
	default n
	help
	  This is support for spreadtrum wireless chip.

if SPARD_WLAN_SUPPORT
source "drivers/net/wireless/uwe5622/sprdwcn/Kconfig"
source "drivers/net/wireless/uwe5622/unisocwifi/Kconfig"
source "drivers/net/wireless/uwe5622/tty-sdio/Kconfig"
endif
```

## drivers/net/wireless/uwe5622/sprdwcn/Kconfig
```kconfig
#
# Spreadtrum WCN device (NEW )configuration
#
menu "Spreadtrum WCN Device Drivers"
config SC23XX
	bool "SC23XX chip Support"
	#depends on MMC
	default n
	help
	  This is support wcn chip for spreadtrum.
	  if you want to use 23xx series wcn chip of spreadtrum.
	  please say "y".

config SC2342_INTEG
	tristate "SC2342 Integrated chip Support"
	depends on SC23XX
	default n
	help
	  This is support wcn chip for spreadtrum.
	  If you want to use sc2342 integrated chip of spreadtrum.
	  Please say "y".

config SC2355
	tristate "SC2355 chip Support"
	depends on SC23XX
	default n
	help
	  This is support wcn chip for spreadtrum.
	  If you want to use sc2355 chip of spreadtrum.
	  Please say "y".

config UMW2652
	tristate "UMW2652 chip Support"
	depends on SC23XX
	default n
	help
	  This is support wcn chip for spreadtrum.
	  If you want to use umw2652 chip of spreadtrum.
	  Please say "y".

config CPLOG_DEBUG
	bool "CP2 debug log Support"
	default n
	help
	  This is support wcn chip for spreadtrum.
	  If you want to use cp2 debug log.
	  Please say "y".

# sprd's SDIO device driver based on SC2355...,etc
source "drivers/net/wireless/uwe5622/sprdwcn/sdio/Kconfig"

# sprd's SIPC device driver based on SC2342 integ...,etc
#source "drivers/net/wireless/uwe5622/sprdwcn/sipc/Kconfig"

# sprd's sleep device driver based on SC2355...,etc
source "drivers/net/wireless/uwe5622/sprdwcn/sleep/Kconfig"

# sprd's PCIe device driver based on SC2355...,etc
#source "drivers/net/wireless/uwe5622/sprdwcn/pcie/Kconfig"

# sprd's wcn platform driver based on SC2355/SC2342...,etc
source "drivers/net/wireless/uwe5622/sprdwcn/platform/Kconfig"

endmenu
```

## drivers/net/wireless/uwe5622/unisocwifi/Kconfig
```kconfig
config WLAN_UWE5622
	tristate "UWE5622 Wi-Fi Driver"
	---help---
	  Spard UWE5622 Wi-Fi Driver.
```
